## conf/layer.conf
```bitbake
# We have a conf and classes directory, append to BBPATH
BBPATH .= ":${LAYERDIR}"

# We have a recipes directory, add to BBFILES
BBFILES += "${LAYERDIR}/recipes*/*/*.bb ${LAYERDIR}/recipes*/*/*.bbappend ${LAYERDIR}/images/*.bb"

BBFILE_COLLECTIONS += "meta-mcce"
BBFILE_PATTERN_meta-mcce := "^${LAYERDIR}/"
BBFILE_PRIORITY_meta-mcce = "16"

LAYERSERIES_COMPAT_meta-mcce = "kirkstone"
```
